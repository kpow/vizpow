#ifndef WLED_FONT_H
#define WLED_FONT_H

#include <Arduino.h>

// ============================================================================
// 3x5 Pixel Font — Compact bitmap font for 32x8 LED matrix
// ============================================================================
// Each printable ASCII character (0x20–0x7E, 95 chars) is encoded as 3 bytes.
// Each byte represents one column (LSB = top row, bit 4 = bottom row).
// At 4px pitch (3px glyph + 1px gap), 8 characters fit in 32 pixels.
//
// Text is vertically centered on the 8-pixel display:
//   Row 0: padding
//   Rows 1–5: glyph
//   Rows 6–7: padding
// ============================================================================

// 3 bytes per character, 95 printable ASCII characters (space through tilde)
static const uint8_t PROGMEM WLED_FONT_3X5[95 * 3] = {
  // 0x20 ' ' (space)
  0x00, 0x00, 0x00,
  // 0x21 '!'
  0x00, 0x17, 0x00,
  // 0x22 '"'
  0x03, 0x00, 0x03,
  // 0x23 '#'
  0x0A, 0x1F, 0x0A,
  // 0x24 '$'
  0x12, 0x1F, 0x09,
  // 0x25 '%'
  0x09, 0x04, 0x12,
  // 0x26 '&'
  0x0A, 0x15, 0x1A,
  // 0x27 '''
  0x00, 0x03, 0x00,
  // 0x28 '('
  0x00, 0x0E, 0x11,
  // 0x29 ')'
  0x11, 0x0E, 0x00,
  // 0x2A '*'
  0x05, 0x02, 0x05,
  // 0x2B '+'
  0x04, 0x0E, 0x04,
  // 0x2C ','
  0x10, 0x08, 0x00,
  // 0x2D '-'
  0x04, 0x04, 0x04,
  // 0x2E '.'
  0x00, 0x10, 0x00,
  // 0x2F '/'
  0x08, 0x04, 0x02,
  // 0x30 '0'
  0x0E, 0x11, 0x0E,
  // 0x31 '1'
  0x12, 0x1F, 0x10,
  // 0x32 '2'
  0x19, 0x15, 0x12,
  // 0x33 '3'
  0x11, 0x15, 0x0A,
  // 0x34 '4'
  0x07, 0x04, 0x1F,
  // 0x35 '5'
  0x17, 0x15, 0x09,
  // 0x36 '6'
  0x0E, 0x15, 0x08,
  // 0x37 '7'
  0x01, 0x19, 0x07,
  // 0x38 '8'
  0x0A, 0x15, 0x0A,
  // 0x39 '9'
  0x02, 0x15, 0x0E,
  // 0x3A ':'
  0x00, 0x0A, 0x00,
  // 0x3B ';'
  0x10, 0x0A, 0x00,
  // 0x3C '<'
  0x04, 0x0A, 0x11,
  // 0x3D '='
  0x0A, 0x0A, 0x0A,
  // 0x3E '>'
  0x11, 0x0A, 0x04,
  // 0x3F '?'
  0x01, 0x15, 0x02,
  // 0x40 '@'
  0x0E, 0x15, 0x16,
  // 0x41 'A'
  0x1E, 0x05, 0x1E,
  // 0x42 'B'
  0x1F, 0x15, 0x0A,
  // 0x43 'C'
  0x0E, 0x11, 0x11,
  // 0x44 'D'
  0x1F, 0x11, 0x0E,
  // 0x45 'E'
  0x1F, 0x15, 0x11,
  // 0x46 'F'
  0x1F, 0x05, 0x01,
  // 0x47 'G'
  0x0E, 0x11, 0x1D,
  // 0x48 'H'
  0x1F, 0x04, 0x1F,
  // 0x49 'I'
  0x11, 0x1F, 0x11,
  // 0x4A 'J'
  0x08, 0x10, 0x0F,
  // 0x4B 'K'
  0x1F, 0x04, 0x1B,
  // 0x4C 'L'
  0x1F, 0x10, 0x10,
  // 0x4D 'M'
  0x1F, 0x02, 0x1F,
  // 0x4E 'N'
  0x1F, 0x06, 0x1F,
  // 0x4F 'O'
  0x0E, 0x11, 0x0E,
  // 0x50 'P'
  0x1F, 0x05, 0x02,
  // 0x51 'Q'
  0x0E, 0x19, 0x16,
  // 0x52 'R'
  0x1F, 0x05, 0x1A,
  // 0x53 'S'
  0x12, 0x15, 0x09,
  // 0x54 'T'
  0x01, 0x1F, 0x01,
  // 0x55 'U'
  0x0F, 0x10, 0x0F,
  // 0x56 'V'
  0x07, 0x18, 0x07,
  // 0x57 'W'
  0x1F, 0x08, 0x1F,
  // 0x58 'X'
  0x1B, 0x04, 0x1B,
  // 0x59 'Y'
  0x03, 0x1C, 0x03,
  // 0x5A 'Z'
  0x19, 0x15, 0x13,
  // 0x5B '['
  0x00, 0x1F, 0x11,
  // 0x5C '\'
  0x02, 0x04, 0x08,
  // 0x5D ']'
  0x11, 0x1F, 0x00,
  // 0x5E '^'
  0x02, 0x01, 0x02,
  // 0x5F '_'
  0x10, 0x10, 0x10,
  // 0x60 '`'
  0x00, 0x01, 0x02,
  // 0x61 'a'
  0x1E, 0x05, 0x1E,
  // 0x62 'b'
  0x1F, 0x15, 0x0A,
  // 0x63 'c'
  0x0E, 0x11, 0x11,
  // 0x64 'd'
  0x1F, 0x11, 0x0E,
  // 0x65 'e'
  0x1F, 0x15, 0x11,
  // 0x66 'f'
  0x1F, 0x05, 0x01,
  // 0x67 'g'
  0x0E, 0x11, 0x1D,
  // 0x68 'h'
  0x1F, 0x04, 0x1F,
  // 0x69 'i'
  0x11, 0x1F, 0x11,
  // 0x6A 'j'
  0x08, 0x10, 0x0F,
  // 0x6B 'k'
  0x1F, 0x04, 0x1B,
  // 0x6C 'l'
  0x1F, 0x10, 0x10,
  // 0x6D 'm'
  0x1F, 0x02, 0x1F,
  // 0x6E 'n'
  0x1F, 0x06, 0x1F,
  // 0x6F 'o'
  0x0E, 0x11, 0x0E,
  // 0x70 'p'
  0x1F, 0x05, 0x02,
  // 0x71 'q'
  0x0E, 0x19, 0x16,
  // 0x72 'r'
  0x1F, 0x05, 0x1A,
  // 0x73 's'
  0x12, 0x15, 0x09,
  // 0x74 't'
  0x01, 0x1F, 0x01,
  // 0x75 'u'
  0x0F, 0x10, 0x0F,
  // 0x76 'v'
  0x07, 0x18, 0x07,
  // 0x77 'w'
  0x1F, 0x08, 0x1F,
  // 0x78 'x'
  0x1B, 0x04, 0x1B,
  // 0x79 'y'
  0x03, 0x1C, 0x03,
  // 0x7A 'z'
  0x19, 0x15, 0x13,
  // 0x7B '{'
  0x04, 0x0E, 0x11,
  // 0x7C '|'
  0x00, 0x1F, 0x00,
  // 0x7D '}'
  0x11, 0x0E, 0x04,
  // 0x7E '~'
  0x02, 0x06, 0x04,
};

// Font metrics
#define WLED_FONT_CHAR_W   3   // Glyph width in pixels
#define WLED_FONT_CHAR_H   5   // Glyph height in pixels
#define WLED_FONT_PITCH    4   // Character pitch (3px glyph + 1px gap)
#define WLED_FONT_Y_OFFSET 1   // Top padding for vertical centering on 8px display

// ============================================================================
// Font rendering functions
// ============================================================================

// Return pixel width of a string (no trailing gap)
inline uint16_t wledFontStringWidth(const char* str) {
  uint16_t len = 0;
  while (*str) { len++; str++; }
  if (len == 0) return 0;
  return len * WLED_FONT_PITCH - 1;  // No gap after last char
}

// Draw a single character into an RGB buffer.
// buf: pointer to row-major RGB buffer (width * height * 3 bytes)
// bufWidth: buffer width in pixels
// cx, cy: top-left corner of glyph in buffer coordinates
// r, g, b: glyph color
inline void wledFontDrawChar(uint8_t* buf, uint16_t bufWidth, uint8_t bufHeight,
                             int16_t cx, int16_t cy,
                             char ch, uint8_t r, uint8_t g, uint8_t b) {
  if (ch < 0x20 || ch > 0x7E) ch = '?';
  uint16_t idx = (ch - 0x20) * 3;

  for (uint8_t col = 0; col < WLED_FONT_CHAR_W; col++) {
    uint8_t colBits = pgm_read_byte(&WLED_FONT_3X5[idx + col]);
    for (uint8_t row = 0; row < WLED_FONT_CHAR_H; row++) {
      if (colBits & (1 << row)) {
        int16_t px = cx + col;
        int16_t py = cy + row;
        if (px >= 0 && px < (int16_t)bufWidth && py >= 0 && py < (int16_t)bufHeight) {
          uint16_t offset = (py * bufWidth + px) * 3;
          buf[offset]     = r;
          buf[offset + 1] = g;
          buf[offset + 2] = b;
        }
      }
    }
  }
}

// Draw a string centered horizontally, vertically offset by WLED_FONT_Y_OFFSET.
// Renders into an RGB pixel buffer for a display of given dimensions.
inline void wledFontDrawString(uint8_t* buf, uint16_t bufWidth, uint8_t bufHeight,
                               const char* str, uint8_t r, uint8_t g, uint8_t b) {
  uint16_t textW = wledFontStringWidth(str);
  int16_t startX = ((int16_t)bufWidth - (int16_t)textW) / 2;
  int16_t curX = startX;

  while (*str) {
    wledFontDrawChar(buf, bufWidth, bufHeight, curX, WLED_FONT_Y_OFFSET,
                     *str, r, g, b);
    curX += WLED_FONT_PITCH;
    str++;
  }
}

#endif // WLED_FONT_H
